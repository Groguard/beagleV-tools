## patches/u-boot/moonwurm_defconfig
```kconfig
CONFIG_ARM=y
CONFIG_ARCH_SUNXI=y
CONFIG_SYS_TEXT_BASE=0x81700000
CONFIG_ENV_SIZE=0x8000
CONFIG_SPL=y
CONFIG_MACH_SUNIV=y
CONFIG_DRAM_CLK=156
CONFIG_DRAM_ZQ=0
# CONFIG_VIDEO_SUNXI is not set
CONFIG_SPL_SPI_SUNXI=y
CONFIG_USE_BOOTARGS=y
CONFIG_BOOTARGS="console=tty0 console=ttyS0,115200 panic=5 rootwait root=/dev/mtdblock3 rw rootfstype=jffs2"
CONFIG_BOOTCOMMAND="sf probe 0; sf read 0x80C00000 0x100000 0x10000; sf read 0x80008000 0x110000 0x4F0000; bootz 0x80008000 - 0x80C00000;"
CONFIG_SYS_SPI_U_BOOT_OFFS=0x8000
CONFIG_CMD_USB_MASS_STORAGE=y
CONFIG_DEFAULT_DEVICE_TREE="moonwurm"
# CONFIG_USB_FUNCTION_FASTBOOT is not set
CONFIG_DM_SPI_FLASH=y
CONFIG_SPI_FLASH_BAR=y
CONFIG_SPI_FLASH_GIGADEVICE=y
CONFIG_SPI_FLASH_MACRONIX=y
CONFIG_SPI_FLASH_WINBOND=y
CONFIG_SPI=y
CONFIG_DM_SPI=y
CONFIG_SUN6I_SPI=y
CONFIG_USB_MUSB_GADGET=y
# CONFIG_USB_MUSB_PIO_ONLY is not set
CONFIG_USB_GADGET_DOWNLOAD=y
# CONFIG_USB_ETHER is not set
```
